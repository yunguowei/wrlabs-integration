## conf/layer.conf
```bitbake
#
# Copyright (C) 2015 Wind River Systems, Inc.
#
BBPATH ?= ""
# We have a conf and classes directory, add to BBPATH
BBPATH := "${LAYERDIR}:${BBPATH}"

# We have a packages directory, add to BBFILES
BBFILES := "${BBFILES} ${LAYERDIR}/recipes-*/*/*.bb \
	${LAYERDIR}/recipes-*/*/*.bbappend \
	${LAYERDIR}/classes/*.bbclass"

BBFILE_COLLECTIONS += "wrlabs-integration"
BBFILE_PATTERN_wrlabs-integration := "^${LAYERDIR}/"
BBFILE_PRIORITY_wrlabs-integration = "9"

# Common licenses used by some packages in this layer
LICENSE_PATH += "${LAYERDIR}/files/common-licenses"

# This should only be incremented on significant changes that will
# cause compatibility issues with other layers
LAYERVERSION_wrlabs-integration = "1"
```

## scripts/lib/wic/canned-wks/cube-gw-ostree-runtime-intel-corei7-64.wks
```
part /boot/efi --source rawcopy --sourceparams="file=cube-gw-ostree-runtime-intel-corei7-64_efi.otaimg"  --ondisk mmcblk --fstype=vfat --label esp --active --align 4
part / --source rawcopy --sourceparams="file=cube-gw-ostree-runtime-intel-corei7-64_boot.otaimg" --ondisk mmcblk --fstype=ext4 --label boot --align 4
part / --source rawcopy --sourceparams="file=cube-gw-ostree-runtime-intel-corei7-64.otaimg" --ondisk mmcblk --fstype=ext4 --label root --align 4
part /var --source rawcopy --sourceparams="file=cube-gw-ostree-runtime-intel-corei7-64_var.otaimg"  --ondisk mmcblk --fstype=ext4 --label fluxdata --active --align 4
```
